## conf/layer.conf
```bitbake
BBPATH .= ":${LAYERDIR}"

BBFILES += "${LAYERDIR}/recipes-*/*/*.bb \
            ${LAYERDIR}/recipes-*/*/*.bbappend"

BBFILE_COLLECTIONS += "ai"
BBFILE_PATTERN_ai = "^${LAYERDIR}/"
BBFILE_PRIORITY_ai = "9"
LAYERVERSION_ai = "1"
LAYERSERIES_COMPAT_ai = "kirkstone"
```
